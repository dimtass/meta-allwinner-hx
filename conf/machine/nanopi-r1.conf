## conf/machine/nanopi-r1.conf
```bitbake
#@TYPE: Machine
#@NAME: nanopi-r1
#@DESCRIPTION: Machine configuration for the FriendlyARM NanoPi R1, based on the Allwinner H3 CPU

require conf/machine/include/sun8i.inc

# KERNEL_DEVICETREE is already set in sun8i.inc to support the overlays
# and SUNXI_KERNEL_DEVICETREE will be appended to KERNEL_DEVICETREE
SUNXI_KERNEL_DEVICETREE = "sun8i-h3-nanopi-r1.dtb"
UBOOT_CONFIG = "nanopi_r1_defconfig"

DEFAULT_OVERLAYS = "usbhost0 usbhost1 usbhost2 h3-uart1"
MODULES = "g_serial"
MODULES_BLACKLIST = ""
BUILD_DESKTOP = "no"
```

## conf/machine/orange-pi-2.conf
```bitbake
#@TYPE: Machine
#@NAME: orange-pi-2
#@DESCRIPTION: Machine configuration for the Orange Pi 2, base on allwinner H3 CPU

require conf/machine/include/sun8i.inc

# KERNEL_DEVICETREE is already set in sun8i.inc to support the overlays
# and SUNXI_KERNEL_DEVICETREE will be appended to KERNEL_DEVICETREE
SUNXI_KERNEL_DEVICETREE = "sun8i-h3-orangepi-2.dtb"
UBOOT_CONFIG = "orangepi_2_defconfig"

DEFAULT_OVERLAYS = ""
MODULES = "8189es #w1-sunxi #w1-gpio #w1-therm #gc2035 #vfe_v4l2 #sunxi-cir"
MODULES_BLACKLIST = ""

MACHINE_FEATURES_append ?= "wifi"
```

## conf/machine/orange-pi-3.conf
```bitbake
#@TYPE: Machine
#@NAME: orange-pi-3
#@DESCRIPTION: Machine configuration for the orange-pi-3, base on Allwinner H5 CPU

require conf/machine/include/sun50iw6.inc

# KERNEL_DEVICETREE is already set in sun50iw6.inc to support the overlays
# and SUNXI_KERNEL_DEVICETREE will be appended to KERNEL_DEVICETREE
SUNXI_KERNEL_DEVICETREE = "allwinner/sun50i-h6-orangepi-3.dtb"
UBOOT_MACHINE = "orangepi_3_defconfig"

DEFAULT_OVERLAYS = ""
MODULES = ""
MODULES_BLACKLIST = ""
```

## conf/machine/orange-pi-lite.conf
```bitbake
#@TYPE: Machine
#@NAME: orange-pi-lite
#@DESCRIPTION: Machine configuration for the Orange Pi Lite, base on allwinner H3 CPU

require conf/machine/include/sun8i.inc

# KERNEL_DEVICETREE is already set in sun8i.inc to support the overlays
# and SUNXI_KERNEL_DEVICETREE will be appended to KERNEL_DEVICETREE
SUNXI_KERNEL_DEVICETREE = "sun8i-h3-orangepi-lite.dtb"
UBOOT_CONFIG = "orangepi_lite_defconfig"

DEFAULT_OVERLAYS = ""
MODULES = "g_serial"
MODULES_BLACKLIST = ""

MACHINE_FEATURES_append ?= "wifi"
```

## conf/machine/orange-pi-lite2.conf
```bitbake
#@TYPE: Machine
#@NAME: orange-pi-lite2
#@DESCRIPTION: Machine configuration for the orange-pi-lite2, base on Allwinner H5 CPU

require conf/machine/include/sun50iw6.inc

# KERNEL_DEVICETREE is already set in sun50iw6.inc to support the overlays
# and SUNXI_KERNEL_DEVICETREE will be appended to KERNEL_DEVICETREE
SUNXI_KERNEL_DEVICETREE = "allwinner/sun50i-h6-orangepi-lite2.dtb"
UBOOT_MACHINE = "orangepi_lite2_defconfig"

DEFAULT_OVERLAYS = ""
MODULES = ""
MODULES_BLACKLIST = ""
```

## conf/machine/orange-pi-one-plus.conf
```bitbake
#@TYPE: Machine
#@NAME: orange-pi-one
#@DESCRIPTION: Machine configuration for the orange-pi-one, base on allwinner H3 CPU

require conf/machine/include/sun50iw6.inc

# KERNEL_DEVICETREE is already set in sun8i.inc to support the overlays
# and SUNXI_KERNEL_DEVICETREE will be appended to KERNEL_DEVICETREE
SUNXI_KERNEL_DEVICETREE = "sun50i-h6-orangepi-one-plus.dtb"
UBOOT_MACHINE = "orangepi_one_plus_defconfig"

DEFAULT_OVERLAYS = ""
MODULES = " "
MODULES_BLACKLIST = ""
```

## conf/machine/orange-pi-one.conf
```bitbake
#@TYPE: Machine
#@NAME: orange-pi-one
#@DESCRIPTION: Machine configuration for the orange-pi-one, base on allwinner H3 CPU

require conf/machine/include/sun8i.inc

# KERNEL_DEVICETREE is already set in sun8i.inc to support the overlays
# and SUNXI_KERNEL_DEVICETREE will be appended to KERNEL_DEVICETREE
SUNXI_KERNEL_DEVICETREE = "sun8i-h3-orangepi-one.dtb"
UBOOT_MACHINE = "orangepi_one_defconfig"

DEFAULT_OVERLAYS = ""
MODULES = "#w1-sunxi #w1-gpio #w1-therm #gc2035 #vfe_v4l2"
MODULES_BLACKLIST = ""
```

## conf/machine/orange-pi-pc-plus.conf
```bitbake
#@TYPE: Machine
#@NAME: orange-pi-pc-plus
#@DESCRIPTION: Machine configuration for the orange-pi-pc-plus, base on allwinner H3 CPU

require conf/machine/include/sun8i.inc

# KERNEL_DEVICETREE is already set in sun8i.inc to support the overlays
# and SUNXI_KERNEL_DEVICETREE will be appended to KERNEL_DEVICETREE
SUNXI_KERNEL_DEVICETREE = "sun8i-h3-orangepi-pc-plus.dtb"
UBOOT_CONFIG = "orangepi_pc_plus_defconfig"

DEFAULT_OVERLAYS = ""
MODULES = ""
MODULES_BLACKLIST = ""

MACHINE_FEATURES_append ?= "wifi"
```

## conf/machine/orange-pi-pc.conf
```bitbake
#@TYPE: Machine
#@NAME: orange-pi-one
#@DESCRIPTION: Machine configuration for the orange-pi-one, base on allwinner H3 CPU

require conf/machine/include/sun8i.inc

# KERNEL_DEVICETREE is already set in sun8i.inc to support the overlays
# and SUNXI_KERNEL_DEVICETREE will be appended to KERNEL_DEVICETREE
SUNXI_KERNEL_DEVICETREE = "sun8i-h3-orangepi-pc.dtb"
UBOOT_MACHINE = "orangepi_pc_defconfig"

DEFAULT_OVERLAYS = ""
MODULES = "8189es #w1-sunxi #w1-gpio #w1-therm #gc2035 #vfe_v4l2 #sunxi-cir"
MODULES_BLACKLIST = ""

MACHINE_FEATURES_append ?= "wifi"
```

## conf/machine/orange-pi-pc2.conf
```bitbake
#@TYPE: Machine
#@NAME: orange-pi-pc2
#@DESCRIPTION: Machine configuration for the orange-pi-pc2, base on Allwinner H5 CPU

require conf/machine/include/sun50iw2.inc

# KERNEL_DEVICETREE is already set in sun50iw2.inc to support the overlays
# and SUNXI_KERNEL_DEVICETREE will be appended to KERNEL_DEVICETREE
SUNXI_KERNEL_DEVICETREE = "allwinner/sun50i-h5-orangepi-pc2.dtb"
UBOOT_CONFIG = "orangepi_pc2_defconfig"

DEFAULT_OVERLAYS = ""
MODULES = ""
MODULES_BLACKLIST = ""
```

## conf/machine/orange-pi-plus.conf
```bitbake
#@TYPE: Machine
#@NAME: orange-pi-plus
#@DESCRIPTION: Machine configuration for the Orange Pi Plus, base on allwinner H3 CPU

require conf/machine/include/sun8i.inc

# KERNEL_DEVICETREE is already set in sun8i.inc to support the overlays
# and SUNXI_KERNEL_DEVICETREE will be appended to KERNEL_DEVICETREE
SUNXI_KERNEL_DEVICETREE = "sun8i-h3-orangepi-plus.dtb"
UBOOT_MACHINE = "orangepi_plus_defconfig"

DEFAULT_OVERLAYS = ""
MODULES = "8189es #w1-sunxi #w1-gpio #w1-therm #gc2035 #vfe_v4l2 #sunxi-cir"
MODULES_BLACKLIST = ""

MACHINE_FEATURES_append ?= "wifi"
```

## conf/machine/orange-pi-plus2e.conf
```bitbake
#@TYPE: Machine
#@NAME: orange-pi-plus2e
#@DESCRIPTION: Machine configuration for the Orange Pi Plus 2e, base on allwinner H3 CPU

require conf/machine/include/sun8i.inc

# KERNEL_DEVICETREE is already set in sun8i.inc to support the overlays
# and SUNXI_KERNEL_DEVICETREE will be appended to KERNEL_DEVICETREE
SUNXI_KERNEL_DEVICETREE = "sun8i-h3-orangepi-plus2e.dtb"
UBOOT_MACHINE = "orangepi_plus2e_defconfig"

DEFAULT_OVERLAYS = ""
```

## conf/machine/orange-pi-prime.conf
```bitbake
#@TYPE: Machine
#@NAME: orange-pi-zero-plus2
#@DESCRIPTION: Machine configuration for the orange-pi-zero-plus2, base on Allwinner H5 CPU

require conf/machine/include/sun50iw2.inc

# KERNEL_DEVICETREE is already set in sun50iw2.inc to support the overlays
# and SUNXI_KERNEL_DEVICETREE will be appended to KERNEL_DEVICETREE
SUNXI_KERNEL_DEVICETREE = "allwinner/sun50i-h5-orangepi-prime.dtb"
UBOOT_MACHINE = "orangepi_prime_defconfig"

DEFAULT_OVERLAYS = "analog-codec"
MODULES = ""
MODULES_BLACKLIST = ""
```

## conf/machine/orange-pi-r1.conf
```bitbake
#@TYPE: Machine
#@NAME: orange-pi-r1
#@DESCRIPTION: Machine configuration for the Orange Pi R1, base on allwinner H3 CPU

require conf/machine/include/sun8i.inc

# KERNEL_DEVICETREE is already set in sun8i.inc to support the overlays
# and SUNXI_KERNEL_DEVICETREE will be appended to KERNEL_DEVICETREE
SUNXI_KERNEL_DEVICETREE = "sun8i-h2-plus-orangepi-r1.dtb"
UBOOT_CONFIG = "orangepi_r1_defconfig"

DEFAULT_OVERLAYS = "usbhost2 usbhost3"
MODULES="g_serial"
MODULES_BLACKLIST = "lima"
BUILD_DESKTOP = "no"

MACHINE_FEATURES_append ?= "wifi"
```

## conf/machine/orange-pi-win.conf
```bitbake
#@TYPE: Machine
#@NAME: orange-pi-win
#@DESCRIPTION: Machine configuration for the orange-pi-zero-plus2, base on Allwinner H5 CPU

require conf/machine/include/sun50i.inc

# KERNEL_DEVICETREE is already set in sun50i.inc to support the overlays
# and SUNXI_KERNEL_DEVICETREE will be appended to KERNEL_DEVICETREE
SUNXI_KERNEL_DEVICETREE = "allwinner/sun50i-a64-orangepi-win.dtb"
UBOOT_MACHINE = "orangepi_win_defconfig"
```

## conf/machine/orange-pi-zero-plus.conf
```bitbake
#@TYPE: Machine
#@NAME: orange-pi-zero-plus2
#@DESCRIPTION: Machine configuration for the orange-pi-zero-plus2, base on Allwinner H5 CPU

require conf/machine/include/sun50iw2.inc

# KERNEL_DEVICETREE is already set in sun50iw2.inc to support the overlays
# and SUNXI_KERNEL_DEVICETREE will be appended to KERNEL_DEVICETREE
SUNXI_KERNEL_DEVICETREE = "allwinner/sun50i-h5-orangepi-zero-plus.dtb"
UBOOT_CONFIG = "orangepi_zero_plus_defconfig"

DEFAULT_OVERLAYS = "usbhost2 usbhost3"
MODULES = "g_serial"
MODULES_BLACKLIST = "lima"
BUILD_DESKTOP = "no"

MACHINE_FEATURES_append ?= "wifi"
```

## conf/machine/orange-pi-zero-plus2-h3.conf
```bitbake
#@TYPE: Machine
#@NAME: orange-pi-zero-plus2-h3
#@DESCRIPTION: Machine configuration for the Orange Pi Zero Plus H3, base on allwinner H3 CPU

require conf/machine/include/sun8i.inc

# KERNEL_DEVICETREE is already set in sun8i.inc to support the overlays
# and SUNXI_KERNEL_DEVICETREE will be appended to KERNEL_DEVICETREE
SUNXI_KERNEL_DEVICETREE = "sun8i-h3-orangepi-zero-plus2.dtb"
UBOOT_CONFIG = "orangepi_zero_plus2_h3_defconfig"

DEFAULT_OVERLAYS = "usbhost2 usbhost3"
MODULES = "g_serial"
MODULES_BLACKLIST = ""

MACHINE_FEATURES_append ?= "wifi"
```

## conf/machine/orange-pi-zero-plus2-h5.conf
```bitbake
#@TYPE: Machine
#@NAME: orange-pi-zero-plus2-h5
#@DESCRIPTION: Machine configuration for the orange-pi-zero-plus2-h5, base on Allwinner H5 CPU

require conf/machine/include/sun50iw2.inc

# KERNEL_DEVICETREE is already set in sun50iw2.inc to support the overlays
# and SUNXI_KERNEL_DEVICETREE will be appended to KERNEL_DEVICETREE
SUNXI_KERNEL_DEVICETREE = "allwinner/sun50i-h5-orangepi-zero-plus2.dtb"
UBOOT_CONFIG = "orangepi_zero_plus2_defconfig"

DEFAULT_OVERLAYS = "gpio-regulator-1.3v usbhost2 usbhost3"
MODULES="g_serial"
MODULES_BLACKLIST = "lima"
BUILD_DESKTOP = "no"

MACHINE_FEATURES_append ?= "wifi"
```

## conf/machine/orange-pi-zero.conf
```bitbake
#@TYPE: Machine
#@NAME: orange-pi-one
#@DESCRIPTION: Machine configuration for the orange-pi-one, base on allwinner H3 CPU

require conf/machine/include/sun8i.inc

# KERNEL_DEVICETREE is already set in sun8i.inc to support the overlays
# and SUNXI_KERNEL_DEVICETREE will be appended to KERNEL_DEVICETREE
SUNXI_KERNEL_DEVICETREE = "sun8i-h2-plus-orangepi-zero.dtb"
UBOOT_CONFIG = "orangepi_zero_defconfig"

DEFAULT_OVERLAYS = "usbhost2 usbhost3"
MODULES="g_serial"
MODULES_BLACKLIST = "lima"
BUILD_DESKTOP = "no"

MACHINE_FEATURES_append ?= "wifi"
```

## scripts/allwinner_template.wks
```
# short-description: Create SD card image with a boot partition
# long-description:
# Create an image that can be written onto a SD card using dd for use
# with allwinner SoC family.
# It uses SPL and u-boot. This is tested for H5
#
part SPL --source rawcopy --sourceparams="file=sunxi-spl.bin" --ondisk mmcblk0 --no-table --align 8
part u-boot --source rawcopy --sourceparams="file=u-boot.itb" --ondisk mmcblk0 --no-table --align 40
part boot --source rawcopy --sourceparams="file=boot.img" --ondisk mmcblk0 --fstype=vfat --label boot --align 2048 --active
part / --source rootfs --ondisk mmcblk0 --fstype=ext4 --label root --align 1024 --extra-space 10240
part swap --size 512 --ondisk mmcblk0 --label swap1 --fstype=swap --align 1024
```
