## conf/machine/nanopi-neo.conf
```bitbake
#@TYPE: Machine
#@NAME: nanopi-neo
#@DESCRIPTION: Machine configuration for the FriendlyARM NanoPi Neo, based on the Allwinner H3 CPU

require conf/machine/include/sun8i.inc

# KERNEL_DEVICETREE is already set in sun8i.inc to support the overlays
# and SUNXI_KERNEL_DEVICETREE will be appended to KERNEL_DEVICETREE
SUNXI_KERNEL_DEVICETREE = "sun8i-h3-nanopi-neo.dtb"
UBOOT_CONFIG = "nanopi_neo_defconfig"

DEFAULT_OVERLAYS = "usbhost1 usbhost2"
MODULES = "g_serial"
MODULES_BLACKLIST = "lima"
BUILD_DESKTOP = "no"
```

## conf/machine/nanopi-neo2.conf
```bitbake
#@TYPE: Machine
#@NAME: nanopi-neo2
#@DESCRIPTION: Machine configuration for the FriendlyARM NanoPi Neo 2, based on the Allwinner H5 SoC.

require conf/machine/include/sun50iw2.inc

# KERNEL_DEVICETREE is already set in sun50iw2.inc to support the overlays
# and SUNXI_KERNEL_DEVICETREE will be appended to KERNEL_DEVICETREE
SUNXI_KERNEL_DEVICETREE = "allwinner/sun50i-h5-nanopi-neo2-v1.1.dtb"
UBOOT_CONFIG = "nanopi_neo2_defconfig"

DEFAULT_OVERLAYS = "usbhost1 usbhost2"
MODULES = ""
MODULES_BLACKLIST = ""
BUILD_DESKTOP = "no"
```
