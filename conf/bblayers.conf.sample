## conf/bblayers.conf.sample
```bitbake
LCONF_VERSION = "7"

BBPATH = "${TOPDIR}"
BSPDIR := "${@os.path.abspath(os.path.dirname(d.getVar('FILE', True)) + '/../..')}"

BBFILES ?= " ${BSPDIR}/sources/meta-dt-framework/images/*.bb"
BBLAYERS = " \
  ${BSPDIR}/sources/meta-allwinner-hx \
  \
  ${BSPDIR}/sources/meta-openembedded/meta-oe \
  ${BSPDIR}/sources/meta-openembedded/meta-python \
  ${BSPDIR}/sources/meta-openembedded/meta-networking \
  ${BSPDIR}/sources/meta-openembedded/meta-filesystems \
  \
  ${BSPDIR}/sources/poky/meta \
  ${BSPDIR}/sources/poky/meta-poky \
"
```

## conf/distro/allwinner-distro-console.conf
```bitbake
require conf/distro/include/allwinner-distro-base.inc

DISTRO = "allwinner-distro-console"
DISTRO_NAME = "Allwinner no backend"

# Remove conflicting backends.
DISTRO_FEATURES_remove = "wayland x11"
```

## conf/distro/allwinner-distro-wayland.conf
```bitbake
require conf/distro/include/allwinner-distro-base.inc

DISTRO = "allwinner-distro-console"
DISTRO_NAME = "Allwinner wayland"

# Remove conflicting backends.
DISTRO_FEATURES_remove = "x11"

# Only compatible with poky versions > zeus (mesa >= 19.1)
PACKAGECONFIG_append_pn-virtual/mesa = "gallium lima"
```

## conf/distro/allwinner-distro-x11.conf
```bitbake
require conf/distro/include/allwinner-distro-base.inc

DISTRO = "allwinner-distro-x11"
DISTRO_NAME = "Allwinner X11"

# Remove conflicting backends.
DISTRO_FEATURES_remove = "wayland"

# Only compatible with poky versions > zeus (mesa >= 19.1)
PACKAGECONFIG_append_pn-virtual/mesa = "gallium lima"
```

## conf/distro/allwinner-distro-xwayland.conf
```bitbake
require conf/distro/include/allwinner-distro-base.inc

DISTRO = "allwinner-distro-console"
DISTRO_NAME = "Allwinner xwayland"

CORE_IMAGE_BASE_INSTALL += "weston weston-init weston-examples gtk+3-demo clutter-1.0-examples"
CORE_IMAGE_BASE_INSTALL += "${@bb.utils.contains('DISTRO_FEATURES', 'x11', 'weston-xwayland matchbox-terminal', '', d)}"
# Only compatible with poky versions > zeus (mesa >= 19.1)
PACKAGECONFIG_append_pn-virtual/mesa = "gallium lima"
```

## conf/distro/include/allwinner-distro-base.inc
```bitbake
require conf/distro/poky.conf

DISTRO = "allwinner-distro-base"
DISTRO_NAME = "Allwinner Distro Base"
SDK_VENDOR = "-allwinnersdk"

MAINTAINER = "Dimitris Tassopoulos <dimtass@gmail.com>"

TARGET_VENDOR = "-allwinner"

# Allwinner BSP default settings

XSERVER ?= "xserver-xorg \
		   xf86-input-libinput \
		   xf86-video-modesetting"

DISTRO_FEATURES += " \
		alsa \
		usbgadget \
		usbhost \
		bluez5 \
		x11 \
		wayland \
		"

DISTRO_FEATURES_append = " systemd"
VIRTUAL-RUNTIME_init_manager = "systemd"
DISTRO_FEATURES_BACKFILL_CONSIDERED = "sysvinit"
VIRTUAL-RUNTIME_initscripts = ""
```

## conf/layer.conf
```bitbake
# We have a conf and classes directory, append to BBPATH
BBPATH .= ":${LAYERDIR}"

# We have a recipes directory, add to BBFILES
BBFILES += "${LAYERDIR}/recipes*/*/*.bb ${LAYERDIR}/recipes*/*/*.bbappend"

BBFILE_COLLECTIONS += "meta-allwinner-hx"
BBFILE_PATTERN_meta-allwinner-hx := "^${LAYERDIR}/"
BBFILE_PRIORITY_meta-allwinner-hx = "10"
LAYERSERIES_COMPAT_meta-allwinner-hx = "morty pyro rocko sumo thud"
```

## conf/local.conf.sample
```bitbake
# Common configuration for all Machine types
AUTHOR = "Dimitris Tassopoulos"
MACHINE ?= "allwinner"
DISTRO ?= "poky"

PACKAGE_CLASSES ?= " package_deb"
USER_CLASSES = "buildstats image-mklibs image-prelink"
CONF_VERSION = "1"

INHERIT += " rm_work"
# For debugging u-boot and kernel
RM_WORK_EXCLUDE += " linux-stable u-boot"

DISTRO_FEATURES_append = " systemd"
VIRTUAL-RUNTIME_init_manager = "systemd"
DISTRO_FEATURES_BACKFILL_CONSIDERED = "sysvinit"

# BB_GENERATE_MIRROR_TARBALLS = "1"

DL_DIR ?= "${BSPDIR}/downloads/"
TMPDIR ?= "${TOPDIR}/tmp"

SDKMACHINE = "x86_64"
## It's a known issue that when you build the SDK using `-c populate_sdk`
# then there are a few packages that conflict with recipes like:
# poky/meta/recipes-core/meta/target-sdk-provides-dummy.bb
# Therefore, in this case we need to remove those packages from out image build.
REMOVE_SDK_CONFLICT_PKGS = "0"

WKS_FILE ?= "${IMGDEPLOYDIR}/${IMAGE_BASENAME}.wks"

# Extra host tools that are used in this BSP
HOSTTOOLS += "lsdiff"

PREFERRED_VERSION_u-boot ?= "v2020.04%"
PREFERRED_VERSION_u-boot-fw-utils ?= "v2020.04%"

PREFERRED_PROVIDER_virtual/kernel ?= "linux-megous"
PREFERRED_VERSION_linux-megous ?= "5.4%"

# In case you need the rt-kernel uncomment the two lines below
#PREFERRED_PROVIDER_virtual/kernel = "linux-megous-rt"
#PREFERRED_VERSION_linux-megous-rt = "5.4%"

#SSID = "YOUR_SSID"
#PSK = YOUR_SSID_PASSWORD"

# Since adding the /lib/firmware blob in the image is not
# always wanted, you can comment out this line if not needed
IMAGE_INSTALL += "armbian-firmware"

# In armbian those flags are enabled by default.
# These are used in meta-allwinner-hx/recipes-kernel/linux/linux-stable.inc
# in order to add extra functionality into the kernel. To disable them
# just set it to `no`
EXTRAWIFI = "yes"
WIREGUARD = "yes"
AUFS = "yes"

# Add your custom config under this line
```

## conf/machine/include/allwinner-defs.inc
```bitbake
# Definitions for creating wks images for the allwinner
#
# Author: Dimitris Tassopoulos <dimtass@gmail.com>

# name of boot partition image, empty value combines the boot and rootfs partitions
SUNXI_BOOT_IMAGE ?= "boot.img"

# device will be used in u-boot and /etc/fstab
SUNXI_STORAGE_DEVICE_sun8i ?= "mmcblk0"
SUNXI_STORAGE_DEVICE_sun50iw2 ?= "mmcblk2"
SUNXI_STORAGE_DEVICE_sun50iw6 ?= "mmcblk2"

# This is the extra space for the rootfs
ROOT_EXTRA_SPACE ?= "4096"

# if you need swap file then add here the size of it
SUNXI_SWAP_SIZE ?= "512"
```

## conf/machine/include/allwinner-overlays.inc
```bitbake
# Temporary disable these dts until I figure out how to integrate them easily
# 
# allwinner/overlay/sun50i-h5-ds1307.dtbo
# overlay/sun8i-h3-ds1307.dtbo

SUN50I_OVERLAYS = " \
        allwinner/overlay/sun50i-h5-analog-codec.dtbo \
        allwinner/overlay/sun50i-h5-cir.dtbo \
        allwinner/overlay/sun50i-h5-i2c0.dtbo \
        allwinner/overlay/sun50i-h5-i2c1.dtbo \
        allwinner/overlay/sun50i-h5-i2c2.dtbo \
        allwinner/overlay/sun50i-h5-pps-gpio.dtbo \
        allwinner/overlay/sun50i-h5-pwm.dtbo \
        allwinner/overlay/sun50i-h5-spdif-out.dtbo \
        allwinner/overlay/sun50i-h5-spi-add-cs1.dtbo \
        allwinner/overlay/sun50i-h5-spi-jedec-nor.dtbo \
        allwinner/overlay/sun50i-h5-spi-spidev.dtbo \
        allwinner/overlay/sun50i-h5-uart1.dtbo \
        allwinner/overlay/sun50i-h5-uart2.dtbo \
        allwinner/overlay/sun50i-h5-uart3.dtbo \
        allwinner/overlay/sun50i-h5-usbhost0.dtbo \
        allwinner/overlay/sun50i-h5-usbhost1.dtbo \
        allwinner/overlay/sun50i-h5-usbhost2.dtbo \
        allwinner/overlay/sun50i-h5-usbhost3.dtbo \
        allwinner/overlay/sun50i-h5-w1-gpio.dtbo \
"

SUN8I_OVERLAYS = " \
        overlay/sun8i-h3-analog-codec.dtbo \
        overlay/sun8i-h3-cir.dtbo \
        overlay/sun8i-h3-i2c0.dtbo \
        overlay/sun8i-h3-i2c1.dtbo \
        overlay/sun8i-h3-i2c2.dtbo \
        overlay/sun8i-h3-pps-gpio.dtbo \
        overlay/sun8i-h3-pwm.dtbo \
        overlay/sun8i-h3-spdif-out.dtbo \
        overlay/sun8i-h3-spi-add-cs1.dtbo \
        overlay/sun8i-h3-spi-jedec-nor.dtbo \
        overlay/sun8i-h3-spi-spidev.dtbo \
        overlay/sun8i-h3-uart1.dtbo \
        overlay/sun8i-h3-uart2.dtbo \
        overlay/sun8i-h3-uart3.dtbo \
        overlay/sun8i-h3-usbhost0.dtbo \
        overlay/sun8i-h3-usbhost1.dtbo \
        overlay/sun8i-h3-usbhost2.dtbo \
        overlay/sun8i-h3-usbhost3.dtbo \
        overlay/sun8i-h3-w1-gpio.dtbo \
"
```

## conf/machine/include/sun-common.inc
```bitbake
PREFERRED_PROVIDER_virtual/xserver = "xserver-xorg"
XSERVER = "xserver-xorg \
           xf86-input-evdev \
           xf86-input-mouse \
           xf86-input-keyboard"

IMAGE_CLASSES += "sdcard_image-sunxi"
IMAGE_FSTYPES += "ext4 tar.gz sunxi-sdimg wic.bz2 wic.bmap"

do_image_wic[depends] += " gptfdisk-native:do_populate_sysroot mtools-native:do_populate_sysroot dosfstools-native:do_populate_sysroot"
# Build wic image after sunxi_sdimg, because we need the 'boot/img' file
do_image_wic[recrdeptask] += " do_image_sunxi_sdimg"

UBOOT_LOCALVERSION = "-g${@d.getVar('SRCPV', True).partition('+')[2][0:7]}"

UBOOT_ENTRYPOINT ?= "0x40008000"

LINUX_VERSION_EXTENSION ?= "-allwinner"

SERIAL_CONSOLES ?= "115200;ttyS0 115200;ttyGS0"
MACHINE_FEATURES ?= "alsa apm keyboard rtc serial screen usbgadget usbhost vfat"

# By default allwinner supports video output, unless specific machine conf disables it
BUILD_DESKTOP ?= "yes"
```

## conf/machine/include/sun50i.inc
```bitbake
require conf/machine/include/arm/arch-armv8a.inc
require conf/machine/include/soc-family.inc
require allwinner-overlays.inc
require sun-common.inc

SOC_FAMILY = "sun50i"

KERNEL_IMAGETYPE ?= "Image"

UBOOT_BINARY ?= "u-boot.itb"
SPL_BINARY ?= "spl/sunxi-spl.bin"

KERNEL_DEVICETREE ?= "${SUN50I_OVERLAYS} ${SUNXI_KERNEL_DEVICETREE}"

OVERLAY_PREFIX ?= "sun50i-h5"
```

## conf/machine/include/sun50iw6.inc
```bitbake
require conf/machine/include/arm/arch-armv8a.inc
require conf/machine/include/soc-family.inc
require sun-common.inc

SOC_FAMILY = "sun50iw6"

KERNEL_IMAGETYPE ?= "Image"

UBOOT_BINARY ?= "u-boot.itb"
SPL_BINARY ?= "spl/sunxi-spl.bin"

KERNEL_DEVICETREE ?= "${SUNXI_KERNEL_DEVICETREE}"

OVERLAY_PREFIX ?= "sun50i-h6"

UBOOT_PATCHES ?= "sun50iw6"
```

## conf/machine/include/sun8i.inc
```bitbake
require conf/machine/include/soc-family.inc
require sun-common.inc
require conf/machine/include/tune-cortexa7.inc

SOC_FAMILY = "sun8i"

# Sub-architecture support
MACHINE_SOCARCH_SUFFIX ?= ""
MACHINE_SOCARCH_SUFFIX_sun4i = "-sun4i"

KERNEL_IMAGETYPE ?= "zImage"

SPL_BINARY ?= "u-boot-sunxi-with-spl.bin"

KERNEL_DEVICETREE ?= "${SUNXI_KERNEL_DEVICETREE}"

OVERLAY_PREFIX ?= "sun8i-h3"
```

## conf/machine/include/sunxi64.inc
```bitbake
SOC_FAMILY ??= ""
include conf/machine/include/soc-family.inc
require allwinner-overlays.inc

PREFERRED_PROVIDER_virtual/xserver = "xserver-xorg"
XSERVER = "xserver-xorg \
           xf86-video-fbturbo \
           xf86-input-evdev \
           xf86-input-mouse \
           xf86-input-keyboard"

PREFERRED_PROVIDER_virtual/kernel ?= "linux-stable"
PREFERRED_VERSION_linux-stable ?= "4.14%"
PREFERRED_PROVIDER_u-boot ?= "u-boot"
PREFERRED_PROVIDER_virtual/bootloader ?= "u-boot"
PREFERRED_VERSION_u-boot ?= "v2018.05%"

KERNEL_IMAGETYPE ?= "Image"

IMAGE_CLASSES += "sdcard_image-sunxi"
IMAGE_FSTYPES += "ext4 tar.gz sunxi-sdimg wic.bz2 wic.bmap"
do_image_wic[depends] += " gptfdisk-native:do_populate_sysroot mtools-native:do_populate_sysroot dosfstools-native:do_populate_sysroot"
# Build wic image after sunxi_sdimg, because we need the 'boot/img' file
do_image_wic[recrdeptask] += " do_image_sunxi_sdimg"

MACHINE_EXTRA_RRECOMMENDS = "kernel-modules"

UBOOT_LOCALVERSION = "-g${@d.getVar('SRCPV', True).partition('+')[2][0:7]}"

UBOOT_ENTRYPOINT ?= "0x40008000"
UBOOT_LOADADDRESS ?= "0x400080OB00"

UBOOT_BINARY ?= "u-boot.itb"
SPL_BINARY ?= "spl/sunxi-spl.bin"

SERIAL_CONSOLE ?= "115200 ttyS0"
MACHINE_FEATURES ?= "alsa apm keyboard rtc serial screen usbgadget usbhost vfat"

KERNEL_DEVICETREE ?= "${SUNXI64_OVERLAYS} ${SUNXI_KERNEL_DEVICETREE}"
```

## conf/machine/nanopi-duo.conf
```bitbake
#@TYPE: Machine
#@NAME: nanopi-duo
#@DESCRIPTION: Machine configuration for the FriendlyARM NanoPi Duo, based on the Allwinner H2 CPU

require conf/machine/include/sun8i.inc

# KERNEL_DEVICETREE is already set in sun8i.inc to support the overlays
# and SUNXI_KERNEL_DEVICETREE will be appended to KERNEL_DEVICETREE
SUNXI_KERNEL_DEVICETREE = "sun8i-h2-plus-nanopi-duo.dtb"
UBOOT_CONFIG = "nanopi_duo_defconfig"

DEFAULT_OVERLAYS = "usbhost1 usbhost2"
MODULES = "g_serial"
MODULES_BLACKLIST = "lima"
BUILD_DESKTOP = "no"

MACHINE_FEATURES_append ?= "wifi"
```

## conf/machine/nanopi-duo2.conf
```bitbake
#@TYPE: Machine
#@NAME: nanopi-duo2
#@DESCRIPTION: Machine configuration for the FriendlyARM NanoPi Duo2, based on the Allwinner H3 CPU

require conf/machine/include/sun8i.inc

# KERNEL_DEVICETREE is already set in sun8i.inc to support the overlays
# and SUNXI_KERNEL_DEVICETREE will be appended to KERNEL_DEVICETREE
SUNXI_KERNEL_DEVICETREE = "sun8i-h3-nanopi-duo2.dtb"
UBOOT_CONFIG = "nanopi_duo2_defconfig"

DEFAULT_OVERLAYS = "usbhost0 usbhost2 usbhost3"
MODULES = "g_serial"
MODULES_BLACKLIST = ""
BUILD_DESKTOP = "no"

MACHINE_FEATURES_append ?= "wifi"
```

## conf/machine/nanopi-k1-plus.conf
```bitbake
#@TYPE: Machine
#@NAME: nanopi-k1-plus
#@DESCRIPTION: Machine configuration for the FriendlyARM NanoPi K1 Plus, based on the Allwinner H5 SoC.

require conf/machine/include/sun50iw2.inc

# KERNEL_DEVICETREE is already set in sun50iw2.inc to support the overlays
# and SUNXI_KERNEL_DEVICETREE will be appended to KERNEL_DEVICETREE
SUNXI_KERNEL_DEVICETREE = "allwinner/sun50i-h5-nanopi-k1-plus.dtb"
UBOOT_MACHINE = "nanopi_k1_plus_defconfig"

DEFAULT_OVERLAYS = "analog-codec"
MODULES = ""
MODULES_BLACKLIST = ""
```

## conf/machine/nanopi-m1-plus.conf
```bitbake
#@TYPE: Machine
#@NAME: nanopi-m1-plus
#@DESCRIPTION: Machine configuration for the FriendlyARM NanoPi Neo, based on the Allwinner H5 SoC.

require conf/machine/include/sun8i.inc

# KERNEL_DEVICETREE is already set in sun8i.inc to support the overlays
# and SUNXI_KERNEL_DEVICETREE will be appended to KERNEL_DEVICETREE
SUNXI_KERNEL_DEVICETREE = "sun8i-h3-nanopi-m1-plus.dtb"
UBOOT_CONFIG = "nanopi_m1_plus_defconfig"

DEFAULT_OVERLAYS = ""
MODULES = "g_serial"
MODULES_BLACKLIST = ""
```

## conf/machine/nanopi-m1.conf
```bitbake
#@TYPE: Machine
#@NAME: nanopi-m1
#@DESCRIPTION: Machine configuration for the FriendlyARM NanoPi M1, based on the Allwinner H3 SoC.

require conf/machine/include/sun8i.inc

# KERNEL_DEVICETREE is already set in sun8i.inc to support the overlays
# and SUNXI_KERNEL_DEVICETREE will be appended to KERNEL_DEVICETREE
SUNXI_KERNEL_DEVICETREE = "sun8i-h3-nanopi-m1.dtb"
UBOOT_CONFIG = "nanopi_m1_defconfig"

DEFAULT_OVERLAYS = ""
MODULES = "g_serial"
MODULES_BLACKLIST = ""
```

## conf/machine/nanopi-neo-air.conf
```bitbake
#@TYPE: Machine
#@NAME: nanopi-neo-air
#@DESCRIPTION: Machine configuration for the FriendlyARM NanoPi Neo Air, based on the Allwinner H3 CPU.

require conf/machine/include/sun8i.inc

# KERNEL_DEVICETREE is already set in sun8i.inc to support the overlays
# and SUNXI_KERNEL_DEVICETREE will be appended to KERNEL_DEVICETREE
SUNXI_KERNEL_DEVICETREE = "sun8i-h3-nanopi-neo-air.dtb"
UBOOT_MACHINE = "nanopi_neo_air_defconfig"

DEFAULT_OVERLAYS = "usbhost1 usbhost2"
MODULES = "#w1-sunxi #w1-gpio #w1-therm #sunxi-cir hci_uart rfcomm hidp dhd g_serial"
MODULES_BLACKLIST = ""
BUILD_DESKTOP = "no"

MACHINE_FEATURES_append ?= "wifi"
```

## conf/machine/nanopi-neo-core2.conf
```bitbake
#@TYPE: Machine
#@NAME: nanopi-neo-core2
#@DESCRIPTION: Machine configuration for the FriendlyARM NanoPi Neo Core2, based on the Allwinner H5 SoC.

require conf/machine/include/sun50iw2.inc

# KERNEL_DEVICETREE is already set in sun50iw2.inc to support the overlays
# and SUNXI_KERNEL_DEVICETREE will be appended to KERNEL_DEVICETREE
SUNXI_KERNEL_DEVICETREE = "allwinner/sun50i-h5-nanopi-neo-core2.dtb"
UBOOT_CONFIG = "nanopi_neo_core2_defconfig"

DEFAULT_OVERLAYS = "usbhost1 usbhost2"
MODULES = "g_serial"
MODULES_BLACKLIST = "lima"
BUILD_DESKTOP = "no"
```

## conf/machine/nanopi-neo-plus2.conf
```bitbake
#@TYPE: Machine
#@NAME: nanopi-neo-plus2
#@DESCRIPTION: Machine configuration for the FriendlyARM NanoPi Neo Plus2, based on the Allwinner H5 SoC.

require conf/machine/include/sun50i.inc

# KERNEL_DEVICETREE is already set in sun50i.inc to support the overlays
# and SUNXI_KERNEL_DEVICETREE will be appended to KERNEL_DEVICETREE
SUNXI_KERNEL_DEVICETREE = "allwinner/sun50i-h5-nanopi-neo-plus2.dtb"
UBOOT_MACHINE = "nanopi_neo_plus2_defconfig"
```
